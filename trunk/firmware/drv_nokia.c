#include "drv_nokia.h"
#include <avr/pgmspace.h>
#include <util/delay.h>

#include "date.h"

#define _NOK_MODE_NORMAL		0x00
#define _NOK_MODE_INVERTED		0xFF


const prog_uchar ascii_table[128][5] = {
	{0x00, 0x00, 0x00, 0x00, 0x00},	/* sp */
	{0x00, 0x00, 0x2f, 0x00, 0x00},	/* ! */
	{0x00, 0x07, 0x00, 0x07, 0x00},	/* " */
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	{0x44, 0x64, 0x54, 0x4C, 0x44}	/* z */
};

static uint8	reverse_mode = _NOK_MODE_NORMAL;
static uint8	_nokia_current_x = 0;

/**
 * @fn void nokia_init(void)
 * @brief nokia LCD initialisation
 */
void
nokia_init(void)
{
	register_set(_DRV_NOKIA_DDR, 0xFF, _DRV_NOKIA_MASK);
	NOK_DC = 1;
	NOK_CS = 1;		/* chip disabled */
	_delay_us(80);
	NOK_RES = 0;		/* reset chip during 250ms */
	_delay_us(96);		/* max (in us) = 768 / F_CPU (in Mhz) => at
				 * 8Mhz, 96 us */
	NOK_RES = 1;

	/**
	 * @note nokia 3210 LCD use pcd8544 controller with LPH7366-1, LPH7779
	 * or LPH7677 LCD matrix
	 */
	nokia_send_command(0x21);	/* Active the LCD. set extended
					 * instruction set ; in function set */
	nokia_send_command(0xC5);	/* Set LCD Vop (Contrast). Vop  was
					 * 0xC5 better is 0xa0  ; vop set */
	nokia_send_command(0x13);	/* LCD bias system 1:48. */

	/**
	 * @note unsigned chars are stored in the display data ram, address
	 * counter, incremented automatically
	 */
	nokia_send_command(0x20);	/* 0x20 for horizontal mode from left
					 * to right, X axe are incremented
					 * automatically, */
	/* 0x22 for vertical addressing ,back on normal instruction set too */
	nokia_send_command(0x09);	/* all on ; display control */

	/* nokia_send_command(0x41); ?? */
	/* nokia_send_command(0x90); ?? */
	/* nokia_send_command(0x20); ?? */

	nokia_clear();
	nokia_gotoxy(0, 0);
}

void
nokia_send_command(const unsigned char command)
{
	NOK_DC = 0;		/* unsigned char is a command it is read with
				 * the eight SCLK pulse */
	NOK_CS = 0;		/* chip enabled */
	nokia_write(command);
	NOK_CS = 1;		/* chip disabled */
}

void
nokia_send_data(const unsigned char data)
{
	NOK_DC = 1;
	NOK_CS = 0;		/* chip enabled */
	nokia_write(data ^ reverse_mode);
	NOK_CS = 1;		/* chip disabled */

	_nokia_current_x++;
	_nokia_current_x %= NOK_SCREEN_WIDTH;
}

void
nokia_write(unsigned char data)
{
	unsigned char	bit;
	for (bit = 8; bit > 0; bit--) {
		NOK_SCLK = 0;

		if (data & 0x80) {
			NOK_SDA = 1;
		} else {
			NOK_SDA = 0;
		}
		NOK_SCLK = 1;
		_delay_us(1);

		data = data << 1;
	}
}

/**
 * @fn void nokia_reset_DDRAM(void)
 * @brief reset all DDRAM (set all bits to zero)
 */
void
nokia_reset_DDRAM(void)
{
	signed char	dch;
	signed char	dcm;
	signed char	dcl;
	NOK_SDA = 0;		/* all data bits will be always set with 0 */
	NOK_DC = 1;
	NOK_CS = 0;
	for (dch = 6; dch > 0; dch--) {	/* 6 rows */
		for (dcm = NOK_SCREEN_WIDTH; dcm > 0; dcm--) {	/* columns */
			for (dcl = 8; dcl > 0; dcl--) {	/* 8 pixels */
				NOK_SCLK = 0;
				NOK_SCLK = 1;
			}
		}
	}
	NOK_CS = 1;
}

/**
 * @fn void nokia_gotoxy (const unsigned char x, const unsigned char y)
 * @brief Move cursor position to (x,y)
 * @param x x position in pixels
 * @param y y position in lines
 */
void
nokia_gotoxy(const unsigned char x, const unsigned char y)
{				/* Nokia LCD Position cursor */
	nokia_send_command(0x40 | (y & 0x07)),	/* Y axe initialisation: 0100
						 * 0yyy	 */
	nokia_send_command(0x80 | (x & 0x7F));	/* X axe initialisation: 1xxx
						 * xxxx */
	_nokia_current_x = x;
}

void
nokia_display_char(const unsigned char ascii)
{
	unsigned char	data[5];
	memcpy_P(data, ascii_table[ascii - 32], 5);

	nokia_send_data(0x00);	/* Display a blank vertical line */
	nokia_send_data(data[0]);
	nokia_send_data(data[1]);
	nokia_send_data(data[2]);
	nokia_send_data(data[3]);
	nokia_send_data(data[4]);
}

void
nokia_display_string(const char *string)
{
	char		c;
	while ((c = pgm_read_byte(string++)))
		nokia_display_char(c);
}

void
nokia_clear(void)
{
	nokia_reset_DDRAM();	/* reset DDRAM, otherwise the lcd is blurred
				 * with random pixels */

	nokia_send_command(0x08);	/* mod control blank change (all off) */
	nokia_send_command(0x0c);	/* mod control normal change */
	_nokia_current_x = 0;
}

void
nokia_set_mode(uint8 mode)
{
	reverse_mode = (mode) ? _NOK_MODE_INVERTED : _NOK_MODE_NORMAL;
}

void
nokia_finish_line(void)
{
	while (0 != _nokia_current_x) {
		nokia_send_data(0x00);
	}
}
